/*
 * Hojicha44 RIGHT half overlay — the split peripheral. BLE-only: no USB
 * HID on the right (the central talks to the host), and the TRRS jack is
 * wired debug-only on the LEFT, so the right half leaves uart0 DISABLED
 * (board default) and defines no pinctrl — the board's uart0_default
 * pins are already the proven TX=P0.06/RX=P0.08 map if it is ever
 * re-enabled for debugging.
 */
#include "hojicha44.dtsi"

/* Right half reports its physical 6 columns at logical offset 6, so both
 * halves share one 12-column transform and one 46-cell keymap (Corne-style
 * col-offset into the combined RC(.,0..11) span). */
&default_transform {
    col-offset = <6>;
};

&left_encoder {
    status = "okay";
};
