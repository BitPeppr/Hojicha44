## boards/shields/hojicha44/Kconfig.shield
```kconfig
config SHIELD_HOJICHA44_LEFT
    def_bool $(shields_list_contains,hojicha44_left)

config SHIELD_HOJICHA44_RIGHT
    def_bool $(shields_list_contains,hojicha44_right)
```

## config/west.yml
```yaml
manifest:
  defaults:
    revision: edf5c0814fd3ea202e43aad2d68fd32e882a518c  # = tag v0.3, pinned (was a movable tag)
  remotes:
    - name: zmkfirmware
      url-base: https://github.com/zmkfirmware
  projects:
    - name: zmk
      remote: zmkfirmware
      import: app/west.yml
  self:
    path: config
```
